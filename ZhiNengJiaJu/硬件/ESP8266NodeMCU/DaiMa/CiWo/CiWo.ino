#include <Arduino.h>
#include <ESP8266WiFi.h>        // 本程序使用 ESP8266WiFi库
#include <ESP8266WiFiMulti.h>   //  ESP8266WiFiMulti库
#include <ESP8266WebServer.h>   //  ESP8266WebServer库

#include <IRremoteESP8266.h>
#include <IRsend.h>

//自动风对应中风
//除湿对应制热
//送风对应通风
//Mesg Desc.: Power: Off  关空调    xxxx0
const uint16_t rawData1[199] = {4432, 4444,  548, 1642,  524, 552,  526, 1618,  548, 1642,  526, 526,  550,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 1618,  548}; 
// 开机->制冷，自动风，温度26     26011
const uint16_t rawData2[199] = {4458, 4446,  548, 1642,  526, 552,  524, 1618,  548, 1616,  552, 526,  550,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 1620,  548};  // COOLIX B2BFD0
// 上一次为->制冷，自动风，温度26   --->>制冷，自动风，温度27     27011
const uint16_t rawData3[199] = {4434, 4442,  548, 1642,  526, 552,  526, 1616,  550, 1642,  526, 526,  550,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 1642,  524};  // COOLIX B2BF90
// 上一次为->制冷，自动风，温度27  --->>制冷，自动风，温度28      28011
const uint16_t rawData4[199] = {4456, 4446,  548, 1618,  550, 528,  548, 1642,  524, 1620,  546, 530,  546,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 1644,  524};  // COOLIX B2BF80
// 上一次为->制冷，自动风，温度28 --->>制冷，自动风，温度27       27011
const uint16_t rawData5[199] = {4434, 4442,  552, 1618,  550, 552,  526, 1616,  550, 1642,  526, 526,  550,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 1620,  548};  // COOLIX B2BF90
// 上一次为->制冷，自动风，温度27 --->>制冷，自动风，温度26       26011
const uint16_t rawData6[199] = {4432, 4468,  524, 1616,  550, 528,  550, 1642,  524, 1644,  524, 552,  524,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 1620,  548};  // COOLIX B2BFD0
// 上一次为->制冷，自动风，温度26 --->>制冷，低风，温度26         26001
const uint16_t rawData7[199] = {4452, 4452,  542, 1624,  522, 578,  522, 1624,  544, 1644,  500, 558,  542,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 1668,  520};  // COOLIX B29FD0
// 上一次为->制冷，自动风，温度27 --->>制冷，低风，温度27         27001
const uint16_t rawData8[199] = {4434, 4468,  524, 1618,  550, 552,  526, 1642,  524, 1620,  548, 530,  546,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 1642,  524};  // COOLIX B29F90
// 上一次为->制冷，自动风，温度28 --->>制冷，低风，温度28         28001
const uint16_t rawData9[199] = {4454, 4470,  524, 1622,  546, 554,  498, 1668,  520, 1624,  546, 532,  544,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 1622,  544};  // COOLIX B29F80
// 上一次为->制冷，中，温度28 --->>制冷，高风，温度28             28021
const uint16_t rawData10[199] = {4458, 4444,  548, 1620,  548, 552,  524, 1618,  548, 1620,  546, 552,  524,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 1618,  548};  // COOLIX B23F80
// 上一次为->制冷，中，温度27 --->>制冷，高风，温度27             27021
const uint16_t rawData11[199] = {4432, 4444,  550, 1642,  524, 526,  550, 1620,  548, 1620,  548, 526,  550,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 1618,  548};  // COOLIX B23F90
// 上一次为->制冷，中，温度26--->>制冷，高风，温度26              26021
const uint16_t rawData12[199] = {4454, 4448,  546, 1622,  544, 534,  546, 1622,  544, 1646,  522, 532,  544,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 1622,  544};  // COOLIX B23FD0
// 上一次为->制冷，高，温度28 --->>制冷，高风，温度27             27021
const uint16_t rawData13[199] = {4404, 4474,  520, 1670,  520, 556,  500, 1646,  520, 1668,  522, 556,  520,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 1668,  520};  // COOLIX B23F90
// 上一次为->制冷，高，温度27--->>制冷，高风，温度26              26021
const uint16_t rawData14[199] = {4458, 4468,  524, 1620,  548, 552,  524, 1618,  548, 1644,  524, 554,  524,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 1620,  546};  // COOLIX B23FD0
//自动风，温度26，除湿--->自动风，温度27，除湿      27111
uint16_t rawData15[199] = {4456, 4446,  548, 1618,  548, 552,  526, 1642,  526, 1618,  548, 552,  524,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 1642,  524};  // COOLIX B21F94
//自动风，温度27，除湿--->自动风，温度28，除湿      28111
uint16_t rawData16[199] = {4456, 4444,  550, 1618,  550, 528,  548, 1642,  524, 1620,  548, 528,  548,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 1618,  548};  // COOLIX B21F84
//自动风，温度26，除湿--->自动风，无温度，送风      xx211
uint16_t rawData17[199] = {4456, 4448,  546, 1620,  546, 554,  500, 1668,  524, 1622,  544, 532,  522,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 1622,  544};  // COOLIX B2BFE4
//自动风，无温度，送风-->低风，无温度，送风         xx201
uint16_t rawData18[199] = {4432, 4446,  548, 1644,  524, 530,  548, 1618,  550, 1618,  548, 528,  548,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 1620,  546};  // COOLIX B29FE4
//低风，无温度，送风-->高风，无温度，送风           xx221
uint16_t rawData19[199] = {4454, 4472,  522, 1646,  522, 534,  542, 1644,  522, 1646,  522, 532,  522,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 1668,  500};  // COOLIX B23FE4

WiFiClient client;//建立WiFi客户端对象

//固定IP地址
ESP8266WiFiMulti wifiMulti;     // 建立ESP8266WiFiMulti对象,对象名称是'wifiMulti'
ESP8266WebServer esp8266_server(80);// 建立网络服务器对象，该对象用于响应HTTP请求。监听端口（80）
IPAddress local_IP(10, 3, 22, 14); // 设置ESP8266-NodeMCU联网后的IP
IPAddress gateway(10, 3, 22, 254);    // 设置网关IP（通常网关IP是WiFI路由IP）
IPAddress subnet(255, 255, 255, 0);   // 设置子网掩码
IPAddress dns(10, 3, 22, 254);           // 设置局域网DNS的IP（通常局域网DNS的IP是WiFI路由IP）

/* 连接您的WIFI SSID和密码 */
#define WIFI_SSID         "206"    
#define WIFI_PASSWD       "12345678"

int ZM_CiWo=-1;
int ZM_CiWo_old=-1;
int NT_CiWo=-1;
int NT_CiWo_old=-1;
int AF_JiaJuDianQi2=-1;
int AF_JiaJuDianQi2_old=-1;

const uint16_t kIrLed = 16;  // ESP8266 GPIO pin to use. Recommended: 16 (D0).
IRsend irsend(kIrLed);  // Set the GPIO to be used to sending the message. 

void setup(){
    Serial.begin(115200);          // 启动串口通讯
    delay(10);
    Serial.println("");
    // 初始化 wifi
    wifiInit(WIFI_SSID, WIFI_PASSWD);
    Serial.println(WiFi.SSID());              // 连接的WiFI名称
    Serial.print("IP address:\t");            // 以及
    Serial.println(WiFi.localIP());           // NodeMCU的IP地址

    esp8266_server.on("/FWQ",XiangYing_FWQ);
    esp8266_server.begin();
    Serial.println("CiWo_esp8266_server,启动");

    pinMode(D1, OUTPUT);
    digitalWrite(D1,LOW);
    pinMode(D2, OUTPUT);
    digitalWrite(D2,LOW);
    
    pinMode(D5, OUTPUT);//家居电器2
    digitalWrite(D5,LOW);

    irsend.begin(); 
}


// 初始化 wifi 连接
void wifiInit(const char *ssid, const char *passphrase)
{
    // 设置开发板网络环境
    if (!WiFi.config(local_IP, gateway, subnet)) {
        Serial.println("Failed to ESP8266 IP"); 
    } 
  WiFi.mode(WIFI_AP_STA);
    WiFi.begin(ssid, passphrase);
    int i=0;
    while (WiFi.status() != WL_CONNECTED)
    {
        delay(1000);
        i++;
        Serial.print("i");
    }
    Serial.println("Connected to AP");
}

void loop() {
    esp8266_server.handleClient();// 处理http服务器访问

    if(ZM_CiWo_old!=ZM_CiWo){
        if(ZM_CiWo==0){
            digitalWrite(D1,LOW);
            digitalWrite(D2,LOW);
        }
        else if(ZM_CiWo==1){
            digitalWrite(D1,HIGH);
            digitalWrite(D2,LOW);
        }
        else if(ZM_CiWo==2){
            digitalWrite(D1,LOW);
            digitalWrite(D2,HIGH);
        }
        else if(ZM_CiWo==3){
            digitalWrite(D1,HIGH);
            digitalWrite(D2,HIGH);
        }
        ZM_CiWo_old=ZM_CiWo;
    }

    if(AF_JiaJuDianQi2_old!=AF_JiaJuDianQi2){
        if(AF_JiaJuDianQi2==1){
            digitalWrite(D5,HIGH);
        }
        else{
            digitalWrite(D5,LOW);
        }
        AF_JiaJuDianQi2_old=AF_JiaJuDianQi2;
    }

    if(NT_CiWo_old!=NT_CiWo){
        NuanTong_do(NT_CiWo);
        NT_CiWo_old=NT_CiWo;
    }
}

void XiangYing_FWQ(){
    ZM_CiWo=esp8266_server.arg("ZM_CiWo").toInt();
    NT_CiWo=esp8266_server.arg("NT_CiWo").toInt();
    AF_JiaJuDianQi2=esp8266_server.arg("AF_JiaJuDianQi2").toInt();
    Serial.print("ZM_CiWo:");
    Serial.println(ZM_CiWo);
}

void NuanTong_do(int data){
    if(data%10==0){
        irsend.sendRaw(rawData1,sizeof(rawData1)/sizeof(rawData1[0]), 38);
    }
    else if(data==26011){
        irsend.sendRaw(rawData2,sizeof(rawData2)/sizeof(rawData2[0]), 38);
    }
    else if(data==27011){
        irsend.sendRaw(rawData3,sizeof(rawData3)/sizeof(rawData3[0]), 38);
    }
    else if(data==28011){
        irsend.sendRaw(rawData4,sizeof(rawData4)/sizeof(rawData4[0]), 38);
    }
    else if(data==26001){
        irsend.sendRaw(rawData7,sizeof(rawData7)/sizeof(rawData7[0]), 38);
    }
    else if(data==27001){
        irsend.sendRaw(rawData8,sizeof(rawData8)/sizeof(rawData8[0]), 38);
    }
    else if(data==28001){
        irsend.sendRaw(rawData9,sizeof(rawData9)/sizeof(rawData9[0]), 38);
    }
    else if(data==28021){
        irsend.sendRaw(rawData10,sizeof(rawData10)/sizeof(rawData10[0]), 38);
    }
    else if(data==27021){
        irsend.sendRaw(rawData11,sizeof(rawData11)/sizeof(rawData11[0]), 38);
    }
    else if(data==26021){
        irsend.sendRaw(rawData12,sizeof(rawData12)/sizeof(rawData12[0]), 38);
    }
    else if(data==27111){
        irsend.sendRaw(rawData15,sizeof(rawData15)/sizeof(rawData15[0]), 38);
    }
    else if(data==28111){
        irsend.sendRaw(rawData16,sizeof(rawData16)/sizeof(rawData16[0]), 38);
    }
    else if(data%1000==211){//xx211
        irsend.sendRaw(rawData17,sizeof(rawData17)/sizeof(rawData17[0]), 38);
    }
    else if(data%1000==201){//xx201
        irsend.sendRaw(rawData18,sizeof(rawData18)/sizeof(rawData18[0]), 38);
    }
    else if(data%1000==221){//xx221
        irsend.sendRaw(rawData19,sizeof(rawData19)/sizeof(rawData19[0]), 38);
    }
}
